## CMakeLists.txt
```
cmake_minimum_required(VERSION 3.20.0)

set(BOARD nrf52840dongle)

find_package(Zephyr REQUIRED HINTS $ENV{ZEPHYR_BASE})
project(cokvm)

target_sources(app PRIVATE
    src/main.c
    src/cokvm_protocol.c
    src/cokvm_ui.c
    src/cokvm_usb.c
    src/cokvm_bt.c
    src/cokvm_shell.c
    src/cokvm_queue.c
)

target_sources_ifdef(CONFIG_COKVM_TESTSUITE app PRIVATE
    src/cokvm_shell_testsuite.c
)
```

## Kconfig
```
menu "CoKVM Configuration"

config COKVM_PASSKEY_PAIRING
	bool "Enable Passkey Entry pairing (more secure)"
	default n
	select BT_SMP_ENFORCE_MITM
	help
	  When enabled, uses Passkey Entry (6-digit code) for Bluetooth pairing
	  instead of Just Works. The passkey will be displayed on the shell
	  console during pairing. This provides MITM protection.

config COKVM_TESTSUITE
	bool "Enable test suite for BLE data injection"
	default n
	help
	  When enabled, adds 'cokvm test' commands for simulating keyboard
	  and mouse input. This is for development testing purposes.

endmenu

source "Kconfig.zephyr"
```

## prj.conf
```kconfig
# ==================== Basic Hardware & System ====================
CONFIG_GPIO=y
CONFIG_LOG=y
CONFIG_LOG_BACKEND_UART=n
CONFIG_LOG_PRINTK=y

CONFIG_LOG_MODE_DEFERRED=y
CONFIG_LOG_BUFFER_SIZE=4096
CONFIG_LOG_PROCESS_THREAD_SLEEP_MS=1

CONFIG_REBOOT=y
CONFIG_MAIN_STACK_SIZE=2048
CONFIG_SYSTEM_WORKQUEUE_STACK_SIZE=4096
CONFIG_BT_RX_STACK_SIZE=2200
CONFIG_BT_CTLR_RX_BUFFERS=4

CONFIG_SERIAL=y
CONFIG_UART_LINE_CTRL=y
CONFIG_SHELL=y
CONFIG_SHELL_BACKEND_SERIAL=y
CONFIG_SHELL_BACKEND_SERIAL_TX_RING_BUFFER_SIZE=512
CONFIG_SETTINGS_SHELL=y

# for nRF52840 dongle
CONFIG_CLOCK_CONTROL_NRF_K32SRC_XTAL=n
CONFIG_CLOCK_CONTROL_NRF_K32SRC_RC=y
CONFIG_CLOCK_CONTROL_NRF_K32SRC_RC_CALIBRATION=y

# Persistent storage settings for Bluetooth pairing keys
CONFIG_SETTINGS=y
CONFIG_FLASH=y
CONFIG_FLASH_MAP=y
CONFIG_NVS=y

# Zephyr 4.x USB-next Core
CONFIG_USB_DEVICE_STACK_NEXT=y
CONFIG_USBD_HID_SUPPORT=y
CONFIG_USBD_HID_IN_BUF_COUNT=6

CONFIG_INPUT=y
CONFIG_CDC_ACM_SERIAL_INITIALIZE_AT_BOOT=n

# Bluetooth Core Config
CONFIG_BT=y
CONFIG_BT_PERIPHERAL=y
CONFIG_BT_DEVICE_NAME="CoKVM-Dongle"
CONFIG_BT_MAX_CONN=1
CONFIG_BT_EXT_ADV=y
CONFIG_BT_EXT_ADV_MAX_ADV_SET=1

CONFIG_BT_SETTINGS=y

# Bluetooth Security Manager Protocol (SMP) for pairing encryption
CONFIG_BT_SMP=y
CONFIG_BT_BONDABLE=y
CONFIG_BT_SMP_ALLOW_UNAUTH_OVERWRITE=y
CONFIG_BT_MAX_PAIRED=5
CONFIG_BT_PRIVACY=n

# CoKVM Passkey Pairing (more secure than Just Works)
# Automatically enables BT_SMP_ENFORCE_MITM via Kconfig select
CONFIG_COKVM_PASSKEY_PAIRING=y
CONFIG_BT_SMP_APP_PAIRING_ACCEPT=y
CONFIG_BT_KEYS_OVERWRITE_OLDEST=y

# GATT service
CONFIG_BT_GATT_CACHING=y
CONFIG_BT_GATT_DYNAMIC_DB=y

# Device Information Service (DIS) - required for macOS BLE HID compliance
CONFIG_BT_DIS=y
CONFIG_BT_DIS_PNP=y
CONFIG_BT_DIS_PNP_VID_SRC=2
CONFIG_BT_DIS_PNP_VID=0x1915
CONFIG_BT_DIS_PNP_PID=0x5211
CONFIG_BT_DIS_PNP_VER=0x0100
CONFIG_BT_DIS_FW_REV=y
CONFIG_BT_DIS_FW_REV_STR="1.0.0"

# Battery Service (BAS) - required for macOS BLE HID compliance
CONFIG_BT_BAS=y

# Low Latency Connection Parameters
CONFIG_BT_GAP_AUTO_UPDATE_CONN_PARAMS=y
CONFIG_BT_PERIPHERAL_PREF_MIN_INT=6
CONFIG_BT_PERIPHERAL_PREF_MAX_INT=12
CONFIG_BT_PERIPHERAL_PREF_LATENCY=0
CONFIG_BT_PERIPHERAL_PREF_TIMEOUT=500
```

## prj_dev.conf
```kconfig
# ==================== Basic Hardware & System ====================
CONFIG_GPIO=y
CONFIG_LOG=y
CONFIG_LOG_BACKEND_UART=n
CONFIG_LOG_PRINTK=y

CONFIG_LOG_MODE_DEFERRED=y
CONFIG_LOG_BUFFER_SIZE=4096
CONFIG_LOG_PROCESS_THREAD_SLEEP_MS=1

CONFIG_REBOOT=y
CONFIG_MAIN_STACK_SIZE=2048
CONFIG_SYSTEM_WORKQUEUE_STACK_SIZE=4096
CONFIG_BT_RX_STACK_SIZE=2200
CONFIG_BT_CTLR_RX_BUFFERS=4

CONFIG_SERIAL=y
CONFIG_UART_LINE_CTRL=y
CONFIG_SHELL=y
CONFIG_SHELL_BACKEND_SERIAL=y
CONFIG_SHELL_BACKEND_SERIAL_TX_RING_BUFFER_SIZE=512
CONFIG_SETTINGS_SHELL=y

CONFIG_EXCEPTION_DEBUG=y

CONFIG_BT_SHELL=y
CONFIG_USBD_SHELL=y

# for nRF52840 dongle
CONFIG_CLOCK_CONTROL_NRF_K32SRC_XTAL=n
CONFIG_CLOCK_CONTROL_NRF_K32SRC_RC=y
CONFIG_CLOCK_CONTROL_NRF_K32SRC_RC_CALIBRATION=y

# Persistent storage settings for Bluetooth pairing keys
CONFIG_SETTINGS=y
CONFIG_FLASH=y
CONFIG_FLASH_MAP=y
CONFIG_NVS=y

# Zephyr 4.x USB-next Core
CONFIG_USB_DEVICE_STACK_NEXT=y
CONFIG_USBD_HID_SUPPORT=y
CONFIG_USBD_HID_IN_BUF_COUNT=6

CONFIG_INPUT=y
CONFIG_CDC_ACM_SERIAL_INITIALIZE_AT_BOOT=n

# Bluetooth Core Config
CONFIG_BT=y
CONFIG_BT_PERIPHERAL=y
CONFIG_BT_DEVICE_NAME="CoKVM-Dongle"
CONFIG_BT_MAX_CONN=1
CONFIG_BT_EXT_ADV=y
CONFIG_BT_EXT_ADV_MAX_ADV_SET=1

CONFIG_BT_SETTINGS=y

# Bluetooth Security Manager Protocol (SMP) for pairing encryption
CONFIG_BT_SMP=y
CONFIG_BT_BONDABLE=y
CONFIG_BT_SMP_ALLOW_UNAUTH_OVERWRITE=y
CONFIG_BT_MAX_PAIRED=5
CONFIG_BT_PRIVACY=n

# CoKVM Passkey Pairing (more secure than Just Works)
# Automatically enables BT_SMP_ENFORCE_MITM via Kconfig select
CONFIG_COKVM_PASSKEY_PAIRING=y
CONFIG_BT_SMP_APP_PAIRING_ACCEPT=y
CONFIG_BT_KEYS_OVERWRITE_OLDEST=y

# GATT service
CONFIG_BT_GATT_CACHING=y
CONFIG_BT_GATT_DYNAMIC_DB=y

# Device Information Service (DIS) - required for macOS BLE HID compliance
CONFIG_BT_DIS=y
CONFIG_BT_DIS_PNP=y
CONFIG_BT_DIS_PNP_VID_SRC=2
CONFIG_BT_DIS_PNP_VID=0x1915
CONFIG_BT_DIS_PNP_PID=0x5211
CONFIG_BT_DIS_PNP_VER=0x0100
CONFIG_BT_DIS_FW_REV=y
CONFIG_BT_DIS_FW_REV_STR="1.0.0"

# Battery Service (BAS) - required for macOS BLE HID compliance
CONFIG_BT_BAS=y

# Low Latency Connection Parameters
CONFIG_BT_GAP_AUTO_UPDATE_CONN_PARAMS=y
CONFIG_BT_PERIPHERAL_PREF_MIN_INT=6
CONFIG_BT_PERIPHERAL_PREF_MAX_INT=12
CONFIG_BT_PERIPHERAL_PREF_LATENCY=0
CONFIG_BT_PERIPHERAL_PREF_TIMEOUT=500
```

## app.overlay
```dts
/ {
    hid_kbd: hid_kbd {
        compatible = "zephyr,hid-device";
        protocol-code = "keyboard";
        label = "USB Composite Keyboard";
        in-report-size = <8>;
        in-polling-period-us = <10000>;
    };

    hid_mouse: hid_mouse {
        compatible = "zephyr,hid-device";
        protocol-code = "mouse";
        label = "USB Composite Mouse";
        in-report-size = <6>;
        in-polling-period-us = <1000>;
    };
};
```

## src/main.c
```c
#include <zephyr/kernel.h>
#include <zephyr/logging/log.h>

BUILD_ASSERT(IS_ENABLED(CONFIG_SETTINGS),
             "CONFIG_SETTINGS must be enabled; otherwise CoKVM cannot save paired hosts.");
BUILD_ASSERT(IS_ENABLED(CONFIG_BT_SETTINGS),
             "CONFIG_BT_SETTINGS must be enabled to link BT bonds with NVS storage.");
BUILD_ASSERT(!IS_ENABLED(CONFIG_BT_PRIVACY),
             "CONFIG_BT_PRIVACY must NOT be enabled for this application.");
BUILD_ASSERT(CONFIG_BT_ID_MAX == 1,
             "CONFIG_BT_ID_MAX must be 1.");

#include "cokvm_protocol.h"
#include "cokvm_ui.h"
#include "cokvm_queue.h"
#include "cokvm_usb.h"
#include "cokvm_bt.h"

LOG_MODULE_REGISTER(cokvm_main, LOG_LEVEL_INF);

int main(void)
{
    int ret;
    LOG_INF("main() thread started.");

    ck_ui_init();

    ret = ck_usb_init();
    if (ret) {
        ck_ui_set_status(COKVM_UI_STATUS_ERROR);
        LOG_ERR("USB Composite init failed: %d", ret);
    } else {
        LOG_INF("USB Composite initialized.");
    }

    ret = ck_bt_init();
    if (ret) {
        ck_ui_set_status(COKVM_UI_STATUS_ERROR);
        LOG_ERR("BLE init failed: %d", ret);
    } else {
        LOG_INF("BLE initialized.");
    }

    ck_queue_info();

    ck_start_tx_work_threads();
    LOG_INF("TX work threads started.");

    while (1) {
        ck_ui_loop();
    }

    return 0;
}
```

## src/cokvm_bt.c
```c
#include <stdint.h>
#include <string.h>
#include <stdbool.h>
#include <zephyr/kernel.h>
#include <zephyr/drivers/hwinfo.h>
#include <zephyr/bluetooth/bluetooth.h>
#include <zephyr/bluetooth/controller.h>
#include <zephyr/bluetooth/hci.h>
#include <zephyr/bluetooth/uuid.h>
#include <zephyr/bluetooth/conn.h>
#include <zephyr/bluetooth/gatt.h>
#include <zephyr/usb/class/hid.h>
#include <zephyr/settings/settings.h>
#include <zephyr/logging/log.h>
#include "cokvm_protocol.h"
#include "cokvm_bt.h"
#include "cokvm_usb.h"
#include "cokvm_queue.h"
#include "cokvm_ui.h"


LOG_MODULE_REGISTER(cokvm_bt, LOG_LEVEL_INF);

#define PAIRING_WINDOW_MS 60000

static struct bt_conn *current_conn = NULL;
static struct k_timer pairing_window_timer;

static bt_addr_le_t last_bonded_peer;

#define BT_UUID_COKVM_VSS_SERVICE_VAL 0xff00
#define BT_UUID_COKVM_VSS_DATA_VAL    0xff1d
#define BT_UUID_COKVM_VSS_INFO_VAL    0xff2c

#define BT_UUID_COKVM_VSS_SERVICE    BT_UUID_DECLARE_16(BT_UUID_COKVM_VSS_SERVICE_VAL)
#define BT_UUID_COKVM_VSS_DATA       BT_UUID_DECLARE_16(BT_UUID_COKVM_VSS_DATA_VAL)
#define BT_UUID_COKVM_VSS_INFO       BT_UUID_DECLARE_16(BT_UUID_COKVM_VSS_INFO_VAL)

static struct bt_le_adv_param adv_param = {
    .options = BT_LE_ADV_OPT_CONN | BT_LE_ADV_OPT_SCANNABLE,
    .interval_min = BT_GAP_ADV_FAST_INT_MIN_2,
    .interval_max = BT_GAP_ADV_FAST_INT_MAX_2,
};

static const struct bt_data ad[] = {
    BT_DATA_BYTES(BT_DATA_FLAGS, (BT_LE_AD_GENERAL | BT_LE_AD_NO_BREDR)),
    BT_DATA_BYTES(BT_DATA_UUID16_ALL,
                  BT_UUID_16_ENCODE(BT_UUID_COKVM_VSS_SERVICE_VAL)),
};

static const struct bt_data sd[] = {
    BT_DATA(BT_DATA_NAME_COMPLETE, CONFIG_BT_DEVICE_NAME, sizeof(CONFIG_BT_DEVICE_NAME) - 1),
    BT_DATA_BYTES(BT_DATA_GAP_APPEARANCE, 0x00, 0x00),
    BT_DATA_BYTES(BT_DATA_UUID16_ALL,
                  BT_UUID_16_ENCODE(BT_UUID_DIS_VAL), BT_UUID_16_ENCODE(BT_UUID_BAS_VAL)),
};

static ssize_t write_vss_data(struct bt_conn *conn, const struct bt_gatt_attr *attr,
                              const void *buf, uint16_t len, uint16_t offset, uint8_t flags);
static ssize_t read_vss_info(struct bt_conn *conn, const struct bt_gatt_attr *attr,
                             void *buf, uint16_t len, uint16_t offset);

BT_GATT_SERVICE_DEFINE(
    vss_service,
    BT_GATT_PRIMARY_SERVICE(BT_UUID_COKVM_VSS_SERVICE),
    BT_GATT_CHARACTERISTIC(BT_UUID_COKVM_VSS_DATA,
        BT_GATT_CHRC_WRITE_WITHOUT_RESP,
        BT_GATT_PERM_WRITE_AUTHEN,
        NULL, write_vss_data, NULL),
    BT_GATT_CHARACTERISTIC(BT_UUID_COKVM_VSS_INFO,
        BT_GATT_CHRC_READ,
        BT_GATT_PERM_READ_AUTHEN,
        read_vss_info, NULL, NULL),
);

static ssize_t read_vss_info(struct bt_conn *conn, const struct bt_gatt_attr *attr,
                             void *buf, uint16_t len, uint16_t offset)
{
    ARG_UNUSED(conn);
    ARG_UNUSED(attr);

    static const char info_str[] = "OK";
    return bt_gatt_attr_read(conn, attr, buf, len, offset,
                             info_str, sizeof(info_str) - 1);
}

static ssize_t write_vss_data(struct bt_conn *conn, const struct bt_gatt_attr *attr,
                              const void *buf, uint16_t len, uint16_t offset, uint8_t flags)
{
    ARG_UNUSED(conn);
    ARG_UNUSED(attr);
    ARG_UNUSED(offset);
    ARG_UNUSED(flags);

    if (len < COKVM_MSG_VSS_LEN) {
        return BT_GATT_ERR(BT_ATT_ERR_INVALID_ATTRIBUTE_LEN);
    }

    const cokvm_vss_payload_t *payload = (const cokvm_vss_payload_t *) buf;

    if (payload->magic_k != COKVM_PROTO_MAGIC_K ||
        payload->magic_m != COKVM_PROTO_MAGIC_M ||
        payload->version != COKVM_PROTO_VERSION_0 ||
        (payload->type < COKVM_MSG_TYPE_KBD_DATA || payload->type > COKVM_MSG_TYPE_LED_STATUS)) {
        return BT_GATT_ERR(BT_ATT_ERR_VALUE_NOT_ALLOWED);
    }

    if (payload->type == COKVM_MSG_TYPE_KBD_DATA || payload->type == COKVM_MSG_TYPE_MOUSE_DATA) {
        if (ck_usb_tx_submit_from_vss_payload(payload)) {
            return BT_GATT_ERR(BT_ATT_ERR_INSUFFICIENT_RESOURCES);
        }
    } else {
        uint8_t target_led_status = payload->data.led_status & COKVM_KBD_LED_MASK;
        LOG_INF("received led: 0x%02x, current: 0x%02x, syncstate: %d", target_led_status, kbd_led, kbd_led_syncstate);

        k_spinlock_key_t key = k_spin_lock(&led_sync_lock);

        if (kbd_led_syncstate == SYNCED) {
            if (target_led_status != kbd_led) {
                uint8_t diff = kbd_led ^ target_led_status;
                kbd_led = target_led_status;
                kbd_led_syncstate = SYNCING;
                sync_retry_count = 0;
                k_spin_unlock(&led_sync_lock, key);
                int ret = ck_usb_tx_submit_led(diff);
                if (ret) {
                    LOG_ERR("ck_usb_tx_submit_led failed with ret %d", ret);
                }
            } else {
                k_spin_unlock(&led_sync_lock, key);
            }
        } else if (kbd_led_syncstate == SYNCING) {
            // Check whether the state has changed
            if (target_led_status == kbd_led) {
                // State matches; ignore
                k_spin_unlock(&led_sync_lock, key);
                LOG_INF("LED status unchanged during sync: 0x%02x", target_led_status);
            } else {
                // State changed; update and restart sync
                uint8_t prev_led = kbd_led;
                kbd_led = target_led_status;
                sync_retry_count = 0;  // Reset retry counter

                k_spin_unlock(&led_sync_lock, key);

                // Send diff to restart sync
                uint8_t diff = prev_led ^ target_led_status;
                LOG_INF("New LED status during sync: 0x%02x -> 0x%02x (diff: 0x%02x)",
                         prev_led, target_led_status, diff);
                int ret = ck_usb_tx_submit_led(diff);
                if (ret) {
                    LOG_ERR("ck_usb_tx_submit_led failed with ret %d", ret);
                }
            }
        } else {
            k_spin_unlock(&led_sync_lock, key);
            LOG_INF("wait for host to set led status");
        }
    }
    return len;
}

static void pairing_window_timeout_cb(struct k_timer *timer)
{
    ARG_UNUSED(timer);

    LOG_INF("pairing window timeout, closing pairing gate");

    bt_set_bondable(false);
    if (ck_ui_get_status() == COKVM_UI_STATUS_PAIRING) {
        ck_ui_set_status(COKVM_UI_STATUS_NORMAL);
    }
}

static void connected(struct bt_conn *conn, uint8_t err)
{
    if (err) {
        LOG_ERR("connection failed (err 0x%02x)", err);
        return;
    }
    LOG_INF("connected successfully");

    current_conn = bt_conn_ref(conn);

    bt_addr_le_copy(&last_bonded_peer, bt_conn_get_dst(conn));
    LOG_INF("saved bonded peer address: %s", bt_addr_le_str(&last_bonded_peer));

    int sec_err = bt_conn_set_security(conn, BT_SECURITY_L2);
    if (sec_err) {
        LOG_ERR("failed to set security: %d", sec_err);
    }
}

static void security_changed(struct bt_conn *conn, bt_security_t level, enum bt_security_err err)
{
    ARG_UNUSED(conn);

    if (err != BT_SECURITY_ERR_SUCCESS) {
        LOG_WRN("security changed failed: err %d level %d", err, level);
        ck_ui_set_status(COKVM_UI_STATUS_CONNECTED);
        return;
    }

    if (level >= BT_SECURITY_L2) {
        LOG_INF("security changed: encrypted connection established (level %d)", level);
    } else {
        LOG_WRN("security changed: level %d below expected", level);
    }
    ck_ui_set_status(COKVM_UI_STATUS_CONNECTED);
}

static void disconnected(struct bt_conn *conn, uint8_t reason)
{
    ARG_UNUSED(conn);
    ARG_UNUSED(reason);

    LOG_INF("disconnected");

    if (current_conn) {
        bt_conn_unref(current_conn);
        current_conn = NULL;
    }

    ck_ui_set_status(COKVM_UI_STATUS_NORMAL);
}

static void recycled(void)
{
    int err;

    err = bt_le_adv_start(&adv_param, ad, ARRAY_SIZE(ad), sd, ARRAY_SIZE(sd));
    if (err) {
        ck_ui_set_status(COKVM_UI_STATUS_ERROR);
        LOG_ERR("recycled: start advertising failed (err %d)", err);
    } else {
        LOG_INF("recycled: advertising started with identity address");
    }
}

BT_CONN_CB_DEFINE(conn_callbacks) = {
    .connected = connected,
    .disconnected = disconnected,
    .recycled = recycled,
    .security_changed = security_changed,
};

static void auth_pairing_complete(struct bt_conn *conn, bool bonded)
{
    ARG_UNUSED(conn);

    LOG_INF("pairing complete, bonded: %s", bonded ? "true" : "false");

    bt_set_bondable(false);

    if (bonded) {
        settings_save();

        LOG_INF("bond saved, entering CONNECTED state");
        ck_ui_set_status(COKVM_UI_STATUS_CONNECTED);
    } else {
        ck_ui_set_status(COKVM_UI_STATUS_NORMAL);
    }

    k_timer_stop(&pairing_window_timer);
}

static void auth_pairing_failed(struct bt_conn *conn, enum bt_security_err reason)
{
    LOG_ERR("pairing failed, reason: %d", reason);

    if (ck_ui_get_status() == COKVM_UI_STATUS_PAIRING) {
        bt_set_bondable(false);
        ck_ui_set_status(COKVM_UI_STATUS_NORMAL);
        k_timer_stop(&pairing_window_timer);
    }
}

static struct bt_conn_auth_info_cb auth_info_callbacks = {
    .pairing_complete = auth_pairing_complete,
    .pairing_failed = auth_pairing_failed,
};

struct bt_bond_check_ctx {
    const bt_addr_le_t *addr;
    bool bonded;
};

static void bond_check(const struct bt_bond_info *info, void *user_data)
{
    struct bt_bond_check_ctx *ctx = (struct bt_bond_check_ctx *)user_data;
    if (bt_addr_le_cmp(&info->addr, ctx->addr) == 0) {
        ctx->bonded = true;
    }
}

static bool is_bonded_device(const struct bt_conn *conn)
{
    struct bt_bond_check_ctx ctx = {
        .addr = bt_conn_get_dst(conn),
        .bonded = false,
    };

    bt_foreach_bond(BT_ID_DEFAULT, bond_check, &ctx);

    return ctx.bonded;
}

#if IS_ENABLED(CONFIG_COKVM_PASSKEY_PAIRING)
static enum bt_security_err pairing_accept(struct bt_conn *conn, const struct bt_conn_pairing_feat * const feat)
{
    ARG_UNUSED(feat);

    if (ck_ui_get_status() == COKVM_UI_STATUS_PAIRING) {
        LOG_INF("accepting pairing attempt within pairing window");
        return 0;
    }

    if (is_bonded_device(conn)) {
        LOG_INF("accepting reconnection from bonded device");
        return 0;
    }

    LOG_WRN("rejecting pairing attempt outside pairing window");
    return BT_SECURITY_ERR_PAIR_NOT_ALLOWED;
}

static void passkey_display(struct bt_conn *conn, unsigned int passkey)
{
    ARG_UNUSED(conn);

    LOG_INF("pairing passkey: %06u", passkey);
}

static void auth_cancel(struct bt_conn *conn)
{
    ARG_UNUSED(conn);
}

static struct bt_conn_auth_cb auth_cb_display = {
    .pairing_accept = pairing_accept,
    .passkey_display = passkey_display,
    .cancel = auth_cancel,
};
#endif

int ck_bt_init(void)
{
    int err;
    uint8_t mac_addr[6];

    hwinfo_get_device_id(mac_addr, sizeof(mac_addr));
    mac_addr[5] = mac_addr[5] | 0xc0;
    bt_ctlr_set_public_addr(mac_addr);

    err = bt_enable(NULL);
    if (err) {
        LOG_ERR("bluetooth init failed (err %d)", err);
        return err;
    }
    settings_load();

#if IS_ENABLED(CONFIG_COKVM_PASSKEY_PAIRING)
    err = bt_conn_auth_cb_register(&auth_cb_display);
    if (err) {
        LOG_ERR("failed to register auth callbacks (err %d)", err);
    }
#endif

    err = bt_conn_auth_info_cb_register(&auth_info_callbacks);
    if (err) {
        LOG_ERR("failed to register auth info callbacks (err %d)", err);
        return err;
    }

    k_timer_init(&pairing_window_timer, pairing_window_timeout_cb, NULL);

    err = bt_le_adv_start(&adv_param, ad, ARRAY_SIZE(ad), sd, ARRAY_SIZE(sd));
    if (err) {
        LOG_ERR("start advertising failed (err %d)", err);
        return err;
    } else {
        LOG_INF("advertising started");
    }

    return 0;
}

void ck_bt_start_pairing_window(void)
{
    LOG_INF("opening pairing window");

    bt_set_bondable(true);
    ck_ui_set_status(COKVM_UI_STATUS_PAIRING);
    k_timer_start(&pairing_window_timer, K_MSEC(PAIRING_WINDOW_MS), K_FOREVER);
}

bool ck_bt_is_connected(void)
{
    return (current_conn != NULL);
}

#if IS_ENABLED(CONFIG_COKVM_TESTSUITE)
int ck_bt_inject_test_data(const cokvm_vss_payload_t *payload)
{
    if (!payload) {
        return -EINVAL;
    }

    if (payload->type == COKVM_MSG_TYPE_KBD_DATA || payload->type == COKVM_MSG_TYPE_MOUSE_DATA) {
        return ck_usb_tx_submit_from_vss_payload(payload);
    }

    return -EINVAL;
}
#endif
```

## src/cokvm_bt.h
```c
#ifndef COKVM_BT_H
#define COKVM_BT_H

#include <stdbool.h>
#include <stdint.h>
#include "cokvm_protocol.h"

int ck_bt_init(void);
void ck_bt_start_pairing_window(void);
bool ck_bt_is_connected(void);
void ck_bt_send_data(uint8_t led_status);

#if IS_ENABLED(CONFIG_COKVM_TESTSUITE)
int ck_bt_inject_test_data(const cokvm_vss_payload_t *data);
#endif

#endif
```

## src/cokvm_protocol.c
```c
#include "cokvm_protocol.h"
```

## src/cokvm_protocol.h
```c
#ifndef COKVM_PROTOCOL_H
#define COKVM_PROTOCOL_H

#include <stdint.h>

#define COKVM_PROTO_MAGIC_K         0x4b
#define COKVM_PROTO_MAGIC_M         0x4d
#define COKVM_PROTO_VERSION_0       0x00

#define COKVM_MSG_TYPE_KBD_DATA     0x01
#define COKVM_MSG_TYPE_MOUSE_DATA   0x02
#define COKVM_MSG_TYPE_LED_STATUS   0x03

#define COKVM_MSG_VSS_PAYLOAD_LEN   22
#define COKVM_MSG_VSS_LEN           22
#define COKVM_MSG_KBD_REPORT_ID     0x01
#define COKVM_MSG_MOUSE_REPORT_ID   0x02

// only care about num lock and caps lock led
#define COKVM_KBD_LED_MASK          (HID_KBD_LED_NUM_LOCK | HID_KBD_LED_CAPS_LOCK)

#define COKVM_KBD_DELAY_UNIT_MS     10

typedef struct {
    uint8_t modifiers;
    uint8_t delay;       /* delay units (10ms each), 0 = immediate */
    uint8_t keycodes[6];
} __packed cokvm_kbd_data_t;

typedef struct {
    uint8_t buttons;
    int16_t x;
    int16_t y;
    int8_t  wheel;
} __packed cokvm_mouse_data_t;

/* to/from USB HID report payload */
typedef struct {
    uint8_t report_id;
    union {
        cokvm_kbd_data_t   kbd;
        cokvm_mouse_data_t mouse;
        uint8_t led_status;
    } data;
} __packed cokvm_usb_payload_t;

/* to/from Bluetooth BLE VSS payload */
typedef struct {
    uint8_t  magic_k;
    uint8_t  magic_m;
    uint8_t  version;
    uint8_t  type;
    union {
        cokvm_kbd_data_t   kbd;
        cokvm_mouse_data_t mouse;
        uint8_t led_status;
    } data;
    uint8_t  reserved[10];
} __packed cokvm_vss_payload_t;

#endif
```

## src/cokvm_queue.c
```c
#include <zephyr/kernel.h>
#include <zephyr/usb/class/usbd_hid.h>
#include <zephyr/logging/log.h>
#include <zephyr/sys/sflist.h>

#include "cokvm_queue.h"
#include "cokvm_bt.h"
#include "cokvm_usb.h"

LOG_MODULE_REGISTER(ck_queue, LOG_LEVEL_INF);

#define COKVM_QUEUE_SLAB_BLOCKS 64

static K_FIFO_DEFINE(kbd_txqueue);
static K_FIFO_DEFINE(mouse_txqueue);

K_MEM_SLAB_DEFINE(queue_slab, ROUND_UP(sizeof(cokvm_txqueue_item_t), 4), COKVM_QUEUE_SLAB_BLOCKS, 4);

static void kbd_tx_worker(void *p1, void *p2, void *p3);
static void mouse_tx_worker(void *p1, void *p2, void *p3);

static struct k_thread kbd_tx_worker_thread_data;
static K_THREAD_STACK_DEFINE(kbd_tx_worker_stack, 512);

static struct k_thread mouse_tx_worker_thread_data;
static K_THREAD_STACK_DEFINE(mouse_tx_worker_stack, 512);

void ck_queue_info(void)
{
    LOG_INF("queue initialized: blocks=%d, item_size=%zu",
            COKVM_QUEUE_SLAB_BLOCKS, sizeof(cokvm_txqueue_item_t));
}

void ck_queue_status(struct ck_queue_status *status)
{
    if (!status) return;

    status->total_blocks = COKVM_QUEUE_SLAB_BLOCKS;
    status->free_blocks = k_mem_slab_num_free_get(&queue_slab);
    status->used_blocks = status->total_blocks - status->free_blocks;
    status->slab_start = (uintptr_t)queue_slab.buffer;
    status->slab_end = (uintptr_t)queue_slab.buffer + queue_slab.info.block_size * queue_slab.info.num_blocks;
    status->block_size = queue_slab.info.block_size;
}

void ck_free_queue_item(cokvm_txqueue_item_t *item)
{
    if (item) {
        k_mem_slab_free(&queue_slab, (void *)item);
    }
}

void ck_free_queue_item_from_report(const cokvm_usb_payload_t *report)
{
    if (!report) return;
    cokvm_txqueue_item_t *item = CONTAINER_OF(report, cokvm_txqueue_item_t, data.usb);
    k_mem_slab_free(&queue_slab, (void *)item);
}

cokvm_txqueue_item_t *ck_queue_peek_tx(void)
{
    return (cokvm_txqueue_item_t *)k_fifo_peek_head(&kbd_txqueue);
}

/* helper function to allocate queue item, memset to 0 */
cokvm_txqueue_item_t *ck_alloc_queue_item(void)
{
    cokvm_txqueue_item_t *item;
    int ret;

    ret = k_mem_slab_alloc(&queue_slab, (void **)&item, K_NO_WAIT);
    if (ret == 0) {
        memset(item, 0, sizeof(cokvm_txqueue_item_t));
        return item;
    } else {
        LOG_WRN("queue item slab alloc failed: %d", ret);
        return NULL;
    }
}

/* extract info from BLE VSS payload and put corresponding USB payload into usb_tx queue */
int ck_usb_tx_submit_from_vss_payload(const cokvm_vss_payload_t *payload)
{
    cokvm_txqueue_item_t *item;

    if (!payload) {
        return -EINVAL;
    }

    item = ck_alloc_queue_item();
    if (!item) {
        return -ENOMEM;
    }

    /*
     * caller must ensure payload type is correct before calling this function.
     * only keyboard and mouse data are used.
     */
    if (payload->type == COKVM_MSG_TYPE_KBD_DATA) {
        item->data.usb.report_id = COKVM_MSG_KBD_REPORT_ID;
        memcpy(&item->data.usb.data.kbd, &payload->data.kbd, sizeof(cokvm_kbd_data_t));
        k_fifo_put(&kbd_txqueue, item);
    } else if (payload->type == COKVM_MSG_TYPE_MOUSE_DATA) {
        item->data.usb.report_id = COKVM_MSG_MOUSE_REPORT_ID;
        memcpy(&item->data.usb.data.mouse, &payload->data.mouse, sizeof(cokvm_mouse_data_t));
        k_fifo_put(&mouse_txqueue, item);
    } else {
        k_mem_slab_free(&queue_slab, (void *)item);
        return -EINVAL;
    }

    return 0;
}

int ck_usb_tx_submit(const cokvm_usb_payload_t *payload)
{
    cokvm_txqueue_item_t *item;

    if (!payload) {
        return -EINVAL;
    }

    item = ck_alloc_queue_item();
    if (!item) {
        return -ENOMEM;
    }

    memcpy(&item->data.usb, payload, sizeof(cokvm_usb_payload_t));

    if (payload->report_id == COKVM_MSG_KBD_REPORT_ID) {
        k_fifo_put(&kbd_txqueue, item);
    } else {
        k_fifo_put(&mouse_txqueue, item);
    }

    return 0;
}

int ck_usb_tx_submit_mouse(const cokvm_usb_payload_t *payload)
{
    cokvm_txqueue_item_t *item;

    if (!payload) {
        return -EINVAL;
    }

    item = ck_alloc_queue_item();
    if (!item) {
        return -ENOMEM;
    }

    memcpy(&item->data.usb, payload, sizeof(cokvm_usb_payload_t));
    k_fifo_put(&mouse_txqueue, item);
    return 0;
}

int ck_usb_tx_submit_led(uint8_t toggle_mask)
{
    cokvm_usb_payload_t payload1 = { .report_id = COKVM_MSG_KBD_REPORT_ID };
    cokvm_usb_payload_t payload2 = { .report_id = COKVM_MSG_KBD_REPORT_ID };
    uint8_t mask = toggle_mask & COKVM_KBD_LED_MASK;

    int i = 0;
    if (mask & HID_KBD_LED_NUM_LOCK) {
        payload1.data.kbd.keycodes[i++] = HID_KEY_NUMLOCK;
    }
    if (mask & HID_KBD_LED_CAPS_LOCK) {
        payload1.data.kbd.keycodes[i++] = HID_KEY_CAPSLOCK;
    }
    if (i == 0) {
        return 0;
    }
    payload2.data.kbd.delay = 1;
    ck_usb_tx_submit(&payload1);
    ck_usb_tx_submit(&payload2);

    return 0;
}

static void kbd_tx_worker(void *p1, void *p2, void *p3)
{
    ARG_UNUSED(p1);
    ARG_UNUSED(p2);
    ARG_UNUSED(p3);

    LOG_INF("kbd_tx worker thread started");

    while (1) {
        cokvm_txqueue_item_t *item = k_fifo_get(&kbd_txqueue, K_FOREVER);
        if (!item) {
            continue;
        }

        uint8_t delay_units = item->data.usb.data.kbd.delay;
        if (delay_units > 0) {
            k_sleep(K_MSEC(delay_units * COKVM_KBD_DELAY_UNIT_MS));
        }

        if (!kbd_ready) {
            k_mem_slab_free(&queue_slab, (void *)item);
            continue;
        }

        item->data.usb.data.kbd.delay = 0;
        int ret = ck_usb_send(&item->data.usb);
        if (ret) {
            k_mem_slab_free(&queue_slab, (void *)item);
        }
    }
}

static void mouse_tx_worker(void *p1, void *p2, void *p3)
{
    ARG_UNUSED(p1);
    ARG_UNUSED(p2);
    ARG_UNUSED(p3);

    LOG_INF("mouse_tx worker thread started");

    while (1) {
        cokvm_txqueue_item_t *item = k_fifo_get(&mouse_txqueue, K_FOREVER);
        if (!item) {
            continue;
        }

        if (!mouse_ready || ck_usb_mouse_throttled()) {
            k_mem_slab_free(&queue_slab, (void *)item);
            continue;
        }

        int ret = ck_usb_send(&item->data.usb);
        if (ret) {
            k_mem_slab_free(&queue_slab, (void *)item);
        }
    }
}

void ck_start_tx_work_threads(void)
{
    k_thread_create(&kbd_tx_worker_thread_data, kbd_tx_worker_stack,
                    K_THREAD_STACK_SIZEOF(kbd_tx_worker_stack),
                    kbd_tx_worker, NULL, NULL, NULL,
                    K_PRIO_COOP(7), 0, K_NO_WAIT);

    k_thread_create(&mouse_tx_worker_thread_data, mouse_tx_worker_stack,
                    K_THREAD_STACK_SIZEOF(mouse_tx_worker_stack),
                    mouse_tx_worker, NULL, NULL, NULL,
                    K_PRIO_COOP(7), 0, K_NO_WAIT);
}
```

## src/cokvm_queue.h
```c
#ifndef COKVM_QUEUE_H
#define COKVM_QUEUE_H

#include <stdint.h>

#include "cokvm_protocol.h"

typedef enum {
    CK_QUEUE_MSG_KBD_DATA,
    CK_QUEUE_MSG_MOUSE_DATA,
    CK_QUEUE_MSG_LED_STATUS,
} cokvm_queue_msg_type_t;

typedef struct {
    void *fifo_reserved;
    union {
        cokvm_usb_payload_t usb;    /* for send to USB */
        cokvm_vss_payload_t vss;    /* for send to Bluetooth */
    } data;
} cokvm_txqueue_item_t;

void ck_queue_info(void);
cokvm_txqueue_item_t *ck_alloc_queue_item();
int ck_usb_tx_submit_from_vss_payload(const cokvm_vss_payload_t *payload);
int ck_usb_tx_submit(const cokvm_usb_payload_t *payload);
int ck_usb_tx_submit_mouse(const cokvm_usb_payload_t *payload);
int ck_usb_tx_submit_led(uint8_t toggle_mask);
void ck_start_tx_work_threads(void);

struct ck_queue_status {
    uint32_t total_blocks;
    uint32_t free_blocks;
    uint32_t used_blocks;
    uintptr_t slab_start;
    uintptr_t slab_end;
    size_t block_size;
};

void ck_queue_status(struct ck_queue_status *status);
void ck_free_queue_item(cokvm_txqueue_item_t *item);
void ck_free_queue_item_from_report(const cokvm_usb_payload_t *report);
cokvm_txqueue_item_t *ck_queue_peek_tx(void);

#endif
```

## src/cokvm_shell.c
```c
#include <zephyr/shell/shell.h>
#include <zephyr/bluetooth/bluetooth.h>
#include <zephyr/bluetooth/conn.h>
#include <zephyr/logging/log.h>
#include "cokvm_bt.h"
#include "cokvm_ui.h"

#if IS_ENABLED(CONFIG_COKVM_TESTSUITE)
extern int cmd_cokvm_test_kbd(const struct shell *sh, size_t argc, char **argv);
extern int cmd_cokvm_test_mmove(const struct shell *sh, size_t argc, char **argv);
extern int cmd_cokvm_test_mbutton(const struct shell *sh, size_t argc, char **argv);
extern int cmd_cokvm_test_status(const struct shell *sh, size_t argc, char **argv);
extern int cmd_cokvm_test_peektx(const struct shell *sh, size_t argc, char **argv);
#endif

LOG_MODULE_REGISTER(cokvm_shell, LOG_LEVEL_INF);

static void bond_list_cb(const struct bt_bond_info *info, void *user_data)
{
    char addr_str[BT_ADDR_LE_STR_LEN];
    const struct shell *sh = (const struct shell *)user_data;

    bt_addr_le_to_str(&info->addr, addr_str, sizeof(addr_str));
    shell_print(sh, "%s", addr_str);
}

static int cmd_cokvm_pair(const struct shell *sh, size_t argc, char **argv)
{
    ARG_UNUSED(argc);
    ARG_UNUSED(argv);

    shell_print(sh, "open pairing window for 1 min");
    ck_bt_start_pairing_window();
    return 0;
}

static int cmd_cokvm_clear(const struct shell *sh, size_t argc, char **argv)
{
    ARG_UNUSED(argc);
    ARG_UNUSED(argv);

    bt_unpair(BT_ID_DEFAULT, BT_ADDR_LE_ANY);
    shell_warn(sh, "all bonds cleared");
    bt_set_bondable(false);
    ck_ui_set_status(COKVM_UI_STATUS_NORMAL);
    return 0;
}

static int cmd_cokvm_list(const struct shell *sh, size_t argc, char **argv)
{
    ARG_UNUSED(argc);
    ARG_UNUSED(argv);

    shell_print(sh, "bonded hosts:");
    bt_foreach_bond(BT_ID_DEFAULT, bond_list_cb, (void *)sh);
    return 0;
}

#if IS_ENABLED(CONFIG_COKVM_TESTSUITE)
SHELL_STATIC_SUBCMD_SET_CREATE(sub_cokvm_test,
    SHELL_CMD(kbd,    NULL, "Inject keyboard string (supports \\n,\\t,\\b,\\e,\\cX)", cmd_cokvm_test_kbd),
    SHELL_CMD(mmove,  NULL, "Move mouse to absolute coordinates x,y", cmd_cokvm_test_mmove),
    SHELL_CMD(mbutton, NULL, "Press mouse button(s) left/right/middle", cmd_cokvm_test_mbutton),
    SHELL_CMD(status, NULL, "Print current system status", cmd_cokvm_test_status),
    SHELL_CMD(peektx, NULL, "Peek USB TX queue head", cmd_cokvm_test_peektx),
    SHELL_SUBCMD_SET_END
);
#endif

SHELL_STATIC_SUBCMD_SET_CREATE(sub_cokvm,
    SHELL_CMD(pair,  NULL, "Open 60s BLE pairing window.", cmd_cokvm_pair),
    SHELL_CMD(clear, NULL, "Purge all saved host bonds.",   cmd_cokvm_clear),
    SHELL_CMD(list,  NULL, "Query and print bond list.",   cmd_cokvm_list),
#if IS_ENABLED(CONFIG_COKVM_TESTSUITE)
    SHELL_CMD(test,  &sub_cokvm_test, "Test injection commands", NULL),
#endif
    SHELL_SUBCMD_SET_END
);

SHELL_CMD_REGISTER(cokvm, &sub_cokvm, "CoKVM Hardware Management Commands", NULL);
```

## src/cokvm_shell_testsuite.c
```c
#include <zephyr/shell/shell.h>
#include <zephyr/kernel.h>
#include <zephyr/logging/log.h>
#include <zephyr/usb/class/hid.h>
#include <string.h>
#include <stdlib.h>
#include "cokvm_bt.h"
#include "cokvm_protocol.h"
#include "cokvm_usb.h"
#include "cokvm_queue.h"

LOG_MODULE_REGISTER(cokvm_shell_testsuite, LOG_LEVEL_INF);

#define TEST_INJECT_DELAY_MS 50
#define MOUSE_COORD_MAX 17280

static const uint8_t ascii_to_hid[] = {
    0x00, 0x00, 0x00, 0x00, 0x00, 0x00, 0x00, 0x00, // 0x00-0x07
    0x2a, 0x2b, 0x28, 0x00, 0x00, 0x00, 0x00, 0x00, // 0x08-0x0f Backspace, Tab, Enter
    0x00, 0x00, 0x00, 0x00, 0x00, 0x00, 0x00, 0x00, // 0x10-0x17
    0x00, 0x00, 0x00, 0x00, 0x00, 0x00, 0x00, 0x00, // 0x18-0x1f
    0x2c, 0x1e, 0x34, 0x20, 0x21, 0x22, 0x24, 0x34, // 0x20-0x27 Space, !, ", #, $, %, &, '
    0x26, 0x27, 0x2d, 0x2e, 0x36, 0x2f, 0x31, 0x30, // 0x28-0x2f (, ), *, +, ,, -, ., /
    0x27, 0x1e, 0x1f, 0x20, 0x21, 0x22, 0x23, 0x24, // 0x30-0x37 0-7
    0x25, 0x26, 0x33, 0x36, 0x37, 0x38, 0x2d, 0x35, // 0x38-0x3f 8-9, :, ;, <, =, >, ?
    0x14, 0x04, 0x05, 0x06, 0x07, 0x08, 0x09, 0x0a, // 0x40-0x47 @, A-G
    0x0b, 0x0c, 0x0d, 0x0e, 0x0f, 0x10, 0x11, 0x12, // 0x48-0x4f H-O
    0x13, 0x14, 0x15, 0x16, 0x17, 0x18, 0x19, 0x1a, // 0x50-0x57 P-W
    0x1b, 0x1c, 0x1d, 0x55, 0x56, 0x54, 0x00, 0x00, // 0x58-0x5f X-Z, [, \, ], ^, _
    0x00, 0x04, 0x05, 0x06, 0x07, 0x08, 0x09, 0x0a, // 0x60-0x67 `, a-g
    0x0b, 0x0c, 0x0d, 0x0e, 0x0f, 0x10, 0x11, 0x12, // 0x68-0x6f h-o
    0x13, 0x14, 0x15, 0x16, 0x17, 0x18, 0x19, 0x1a, // 0x70-0x77 p-w
    0x1b, 0x1c, 0x1d, 0x55, 0x56, 0x54, 0x4c, 0x00, // 0x78-0x7f x-z, {, |, }, ~, DEL
};

static uint8_t char_to_keycode(char c)
{
    uint8_t idx = (uint8_t)c;
    if (idx >= sizeof(ascii_to_hid)) {
        return 0;
    }
    return ascii_to_hid[idx];
}

static int inject_kbd_event(uint8_t modifiers, uint8_t keycode)
{
    cokvm_vss_payload_t payload = {
        .magic_k = COKVM_PROTO_MAGIC_K,
        .magic_m = COKVM_PROTO_MAGIC_M,
        .version = COKVM_PROTO_VERSION_0,
        .type = COKVM_MSG_TYPE_KBD_DATA,
    };

    payload.data.kbd.modifiers = modifiers;
    payload.data.kbd.keycodes[0] = keycode;

    return ck_bt_inject_test_data(&payload);
}

int cmd_cokvm_test_kbd(const struct shell *sh, size_t argc, char **argv)
{
    if (argc < 2) {
        shell_error(sh, "Usage: cokvm test kbd \"string\" | capslock | numlock");
        return -EINVAL;
    }

    const char *arg = argv[1];

    if (strcmp(arg, "capslock") == 0) {
        inject_kbd_event(0, HID_KEY_CAPSLOCK);
        k_msleep(TEST_INJECT_DELAY_MS);
        inject_kbd_event(0, 0x00);
        k_msleep(TEST_INJECT_DELAY_MS);
        shell_print(sh, "Injected capslock toggle");
        return 0;
    }

    if (strcmp(arg, "numlock") == 0) {
        inject_kbd_event(0, HID_KEY_NUMLOCK);
        k_msleep(TEST_INJECT_DELAY_MS);
        inject_kbd_event(0, 0x00);
        k_msleep(TEST_INJECT_DELAY_MS);
        shell_print(sh, "Injected numlock toggle");
        return 0;
    }

    size_t len = strlen(arg);

    for (size_t i = 0; i < len; i++) {
        char c = arg[i];
        uint8_t modifiers = 0;
        uint8_t keycode = 0;

        if (c == '\\' && i + 1 < len) {
            i++;
            char next = arg[i];

            switch (next) {
            case 'n': keycode = 0x28; break;
            case 't': keycode = 0x2b; break;
            case 'b': keycode = 0x2a; break;
            case 'e': keycode = 0x29; break;
            case 'c':
                if (i + 1 < len) {
                    i++;
                    char ctrl_key = arg[i];
                    keycode = char_to_keycode(ctrl_key);
                    if (keycode != 0) {
                        modifiers = 0x01;
                    }
                }
                break;
            case '\\': keycode = 0x56; break;
            default: keycode = char_to_keycode(next); break;
            }
        } else {
            keycode = char_to_keycode(c);
            if (keycode != 0 && (c >= 'A' && c <= 'Z')) {
                modifiers = 0x02;
            }
        }

        if (keycode != 0) {
            inject_kbd_event(modifiers, keycode);
            k_msleep(TEST_INJECT_DELAY_MS);
            inject_kbd_event(modifiers, 0x00);
            k_msleep(TEST_INJECT_DELAY_MS);
        }
    }

    shell_print(sh, "Injected keyboard string: %s", arg);
    return 0;
}

int cmd_cokvm_test_mmove(const struct shell *sh, size_t argc, char **argv)
{
    if (argc < 2) {
        shell_error(sh, "Usage: cokvm test mmove x,y");
        return -EINVAL;
    }

    char *token = strtok(argv[1], ",");
    if (!token) {
        shell_error(sh, "Invalid coordinate format");
        return -EINVAL;
    }

    int x = atoi(token);
    token = strtok(NULL, ",");
    if (!token) {
        shell_error(sh, "Invalid coordinate format");
        return -EINVAL;
    }

    int y = atoi(token);

    if (x < 0) x = 0;
    if (x > MOUSE_COORD_MAX) x = MOUSE_COORD_MAX;
    if (y < 0) y = 0;
    if (y > MOUSE_COORD_MAX) y = MOUSE_COORD_MAX;
    cokvm_vss_payload_t payload = {
        .magic_k = COKVM_PROTO_MAGIC_K,
        .magic_m = COKVM_PROTO_MAGIC_M,
        .version = COKVM_PROTO_VERSION_0,
        .type = COKVM_MSG_TYPE_MOUSE_DATA,
    };

    payload.data.mouse.buttons = 0;
    payload.data.mouse.x = (int16_t)x;
    payload.data.mouse.y = (int16_t)y;
    payload.data.mouse.wheel = 0;

    int ret = ck_bt_inject_test_data(&payload);
    if (ret == 0) {
        shell_print(sh, "Mouse moved to (%d, %d)", x, y);
    } else {
        shell_error(sh, "Failed to inject mouse move");
    }

    return ret;
}

static uint8_t parse_mouse_button(const char *btn_str)
{
    if (strcmp(btn_str, "left") == 0) return 0x01;
    if (strcmp(btn_str, "right") == 0) return 0x02;
    if (strcmp(btn_str, "middle") == 0) return 0x04;
    return 0;
}

int cmd_cokvm_test_mbutton(const struct shell *sh, size_t argc, char **argv)
{
    if (argc < 2) {
        shell_error(sh, "Usage: cokvm test mbutton button[,button...]");
        return -EINVAL;
    }

    uint8_t buttons = 0;
    char *token = strtok(argv[1], ",");

    while (token != NULL) {
        uint8_t btn = parse_mouse_button(token);
        if (btn != 0) {
            buttons |= btn;
        }
        token = strtok(NULL, ",");
    }

    if (buttons == 0) {
        shell_error(sh, "No valid button specified");
        return -EINVAL;
    }

    cokvm_vss_payload_t payload = {
        .magic_k = COKVM_PROTO_MAGIC_K,
        .magic_m = COKVM_PROTO_MAGIC_M,
        .version = COKVM_PROTO_VERSION_0,
        .type = COKVM_MSG_TYPE_MOUSE_DATA,
    };

    payload.data.mouse.buttons = buttons;
    payload.data.mouse.x = 0;
    payload.data.mouse.y = 0;
    payload.data.mouse.wheel = 0;

    ck_bt_inject_test_data(&payload);
    k_msleep(TEST_INJECT_DELAY_MS);

    payload.data.mouse.buttons = 0;
    ck_bt_inject_test_data(&payload);

    shell_print(sh, "Mouse button(s) pressed: 0x%02x", buttons);
    return 0;
}

int cmd_cokvm_test_status(const struct shell *sh, size_t argc, char **argv)
{
    ARG_UNUSED(argc);
    ARG_UNUSED(argv);

    struct ck_queue_status qs;
    ck_queue_status(&qs);

    shell_print(sh, "=== CoKVM Status ===");
    shell_print(sh, "USB:");
    shell_print(sh, "  kbd_ready:      %s", kbd_ready ? "true" : "false");
    shell_print(sh, "  mouse_ready:    %s", mouse_ready ? "true" : "false");
    shell_print(sh, "  kbd_led:        0x%02x", kbd_led);
    shell_print(sh, "  kbd_led_syncstate: %d (%s)", kbd_led_syncstate,
                kbd_led_syncstate == INITIALIZING ? "INITIALIZING" :
                kbd_led_syncstate == SYNCING ? "SYNCING" : "SYNCED");
    shell_print(sh, "Queue:");
    shell_print(sh, "  total_blocks:   %u", qs.total_blocks);
    shell_print(sh, "  free_blocks:    %u", qs.free_blocks);
    shell_print(sh, "  used_blocks:    %u", qs.used_blocks);
    shell_print(sh, "  slab_start:     0x%lx", qs.slab_start);
    shell_print(sh, "  slab_end:       0x%lx", qs.slab_end);
    shell_print(sh, "  block_size:     %zu", qs.block_size);
    shell_print(sh, "BT:");
    shell_print(sh, "  connected:      %s", ck_bt_is_connected() ? "true" : "false");

    return 0;
}

int cmd_cokvm_test_peektx(const struct shell *sh, size_t argc, char **argv)
{
    ARG_UNUSED(argc);
    ARG_UNUSED(argv);

    cokvm_txqueue_item_t *item = ck_queue_peek_tx();

    if (!item) {
        shell_print(sh, "USB TX queue is empty");
        return 0;
    }

    shell_print(sh, "USB TX queue head:");
    shell_print(sh, "  item address:   0x%lx", (uintptr_t)item);
    shell_print(sh, "  report_id:      %d", item->data.usb.report_id);

    if (item->data.usb.report_id == COKVM_MSG_KBD_REPORT_ID) {
        shell_print(sh, "  type:           keyboard");
        shell_print(sh, "  modifiers:      0x%02x", item->data.usb.data.kbd.modifiers);
        shell_print(sh, "  keycodes:       0x%02x 0x%02x 0x%02x 0x%02x 0x%02x 0x%02x",
                    item->data.usb.data.kbd.keycodes[0],
                    item->data.usb.data.kbd.keycodes[1],
                    item->data.usb.data.kbd.keycodes[2],
                    item->data.usb.data.kbd.keycodes[3],
                    item->data.usb.data.kbd.keycodes[4],
                    item->data.usb.data.kbd.keycodes[5]);
    } else if (item->data.usb.report_id == COKVM_MSG_MOUSE_REPORT_ID) {
        shell_print(sh, "  type:           mouse");
        shell_print(sh, "  buttons:        0x%02x", item->data.usb.data.mouse.buttons);
        shell_print(sh, "  x:              %d", item->data.usb.data.mouse.x);
        shell_print(sh, "  y:              %d", item->data.usb.data.mouse.y);
        shell_print(sh, "  wheel:          %d", item->data.usb.data.mouse.wheel);
    }

    return 0;
}

int cmd_cokvm_test_kbd(const struct shell *sh, size_t argc, char **argv);
int cmd_cokvm_test_mmove(const struct shell *sh, size_t argc, char **argv);
int cmd_cokvm_test_mbutton(const struct shell *sh, size_t argc, char **argv);
int cmd_cokvm_test_status(const struct shell *sh, size_t argc, char **argv);
int cmd_cokvm_test_peektx(const struct shell *sh, size_t argc, char **argv);
```

## src/cokvm_ui.c
```c
#include <zephyr/kernel.h>
#include <zephyr/drivers/gpio.h>
#include <zephyr/logging/log.h>
#include "cokvm_ui.h"

LOG_MODULE_REGISTER(cokvm_ui, LOG_LEVEL_INF);

static volatile enum cokvm_ui_status ui_status = COKVM_UI_STATUS_NORMAL;

static const struct gpio_dt_spec led_mono      = GPIO_DT_SPEC_GET(DT_ALIAS(led0), gpios);
static const struct gpio_dt_spec led_rgb_red    = GPIO_DT_SPEC_GET(DT_NODELABEL(led1_red), gpios);
static const struct gpio_dt_spec led_rgb_green  = GPIO_DT_SPEC_GET(DT_NODELABEL(led1_green), gpios);
static const struct gpio_dt_spec led_rgb_blue   = GPIO_DT_SPEC_GET(DT_NODELABEL(led1_blue), gpios);

static const char *const ui_status_str[] = {
    "normal",
    "pairing",
    "connected",
    "error"
};

void ck_ui_init(void)
{
    gpio_pin_configure_dt(&led_mono, GPIO_OUTPUT_INACTIVE);
    gpio_pin_configure_dt(&led_rgb_red, GPIO_OUTPUT_INACTIVE);
    gpio_pin_configure_dt(&led_rgb_green, GPIO_OUTPUT_INACTIVE);
    gpio_pin_configure_dt(&led_rgb_blue, GPIO_OUTPUT_INACTIVE);
}

void ck_ui_set_status(enum cokvm_ui_status status)
{
    ui_status = status;
    LOG_INF("status updated to: %s", ui_status_str[status]);
}

enum cokvm_ui_status ck_ui_get_status(void)
{
    return ui_status;
}

void ck_ui_loop(void)
{
    switch (ui_status) {
    case COKVM_UI_STATUS_PAIRING:
        gpio_pin_set_dt(&led_rgb_red, 0);
        gpio_pin_set_dt(&led_rgb_green, 0);
        gpio_pin_toggle_dt(&led_rgb_blue);
        k_msleep(200);
        break;

    case COKVM_UI_STATUS_CONNECTED:
        gpio_pin_set_dt(&led_rgb_red, 0);
        gpio_pin_set_dt(&led_rgb_blue, 0);
        gpio_pin_set_dt(&led_rgb_green, 1);
        k_msleep(1000);
        break;

    case COKVM_UI_STATUS_ERROR:
        gpio_pin_set_dt(&led_rgb_green, 0);
        gpio_pin_set_dt(&led_rgb_blue, 0);
        gpio_pin_toggle_dt(&led_rgb_red);
        k_msleep(500);
        break;

    case COKVM_UI_STATUS_NORMAL:
    default:
        gpio_pin_set_dt(&led_rgb_blue, 0);
        gpio_pin_set_dt(&led_rgb_red, 0);
        gpio_pin_set_dt(&led_rgb_green, 0);
        k_msleep(1000);
        break;
    }
}
```

## src/cokvm_ui.h
```c
#ifndef COKVM_UI_H
#define COKVM_UI_H

#include <zephyr/kernel.h>

enum cokvm_ui_status {
    COKVM_UI_STATUS_NORMAL,
    COKVM_UI_STATUS_PAIRING,
    COKVM_UI_STATUS_CONNECTED,
    COKVM_UI_STATUS_ERROR
};

void ck_ui_init(void);
void ck_ui_set_status(enum cokvm_ui_status status);
enum cokvm_ui_status ck_ui_get_status(void);
void ck_ui_loop(void);

#endif
```

## src/cokvm_usb.h
```c
#ifndef COKVM_USB_H
#define COKVM_USB_H

#include "cokvm_protocol.h"
#include <zephyr/spinlock.h>

typedef enum {
    INITIALIZING,
    SYNCING,
    SYNCED,
} state_t;

extern struct k_spinlock led_sync_lock;
extern uint8_t kbd_led;
extern state_t kbd_led_syncstate;
extern uint8_t sync_retry_count;
extern bool kbd_ready;
extern bool mouse_ready;

#define MAX_RETRY 3

int ck_usb_init(void);
int ck_usb_send(const cokvm_usb_payload_t *payload);
bool ck_usb_mouse_throttled(void);

#endif
```
